## conf/layer.conf
```bitbake
#
# Copyright (C) 2015 - 2021 Wind River Systems, Inc.
#

# We have a conf and classes directory, add to BBPATH
BBPATH =. "${LAYERDIR}:"

# We have a packages directory, add to BBFILES
BBFILES += "${LAYERDIR}/recipes-*/*/*.bb \
 	${LAYERDIR}/recipes-*/*/*.bbappend"

BBFILE_COLLECTIONS += "wr-axxiaarm"
BBFILE_PATTERN_wr-axxiaarm = "^${LAYERDIR}/"
BBFILE_PRIORITY_wr-axxiaarm = "7"

PREFERRED_PROVIDER_virtual/kernel ?= "linux-yocto"
# Let the "No recipes available for: pkg.bbapeend" be WARNINGS until we
# cleanup the unused bbappend.
BB_DANGLINGAPPENDS_WARNONLY ?= "true"
# This should only be incremented on significant changes that will
# cause compatibility issues with other layers
LAYERVERSION_wr-axxiaarm = "1"

LAYERDEPENDS_wr-axxiaarm = "core wrlinux"
LAYERRECOMMENDS_wr-axxiaarm = "axxiaarm-dl"
LAYERSERIES_COMPAT_wr-axxiaarm = "wrl hardknott"
```

## conf/machine/axxiaarm.conf
```bitbake
#@TYPE: Machine
#@NAME: axxiaarm
#@DESCRIPTION: Machine configuration for Axxia AXM5516 SoC
DEFAULTTUNE ?= "cortexa15t-neon"
require conf/machine/include/tune-cortexa15.inc

MACHINE_FEATURES += "ext2 vfat usbhost"

KERNEL_IMAGETYPE = "uImage"
KERNEL_DEVICETREE = "axm5516-amarillo.dtb \
                         axm5516-sim.dtb"

SERIAL_CONSOLES = "9600;ttyAMA0"
WKS_FILE ?= "axxiaarm-usbimage.wks"
IMAGE_FSTYPES += "tar.bz2 wic wic.bmap"
do_image_wic[depends] += "mtools-native:do_populate_sysroot"
IMAGE_BOOT_FILES ?= "uImage axm5516-amarillo.dtb"

UBOOT_MACHINE_axxiaarm = "axxia-55xx"

# The loader is flashed into other device separately and not part of the SD image
OSTREE_BOOTLOADER_INCLUDE ?= ""
OSTREE_SD_UBOOT_WIC1 ?= ""
OSTREE_SD_UBOOT_WIC2 ?= ""
OSTREE_SD_UBOOT_WIC3 ?= ""
OSTREE_SD_UBOOT_WIC4 ?= ""

DEFAULT_DTB = "axm5516-amarillo.dtb"

# Because of the size of boot loader is ~64M and it must be added
# to 64
OSTREE_WKS_EFI_SIZE ?= "--size=128M"
OSTREE_FDISK_FSZ ?= "128"

OSTREE_UBOOT_CMD ?= "bootm"
INITRAMFS_IMAGE ??= ""
IMAGE_BOOT_FILES_append = " \
    ${@bb.utils.contains('DISTRO_FEATURES', 'ostree', 'boot.scr', '', d)} \
    ${@bb.utils.contains('DISTRO_FEATURES', 'ostree', '${INITRAMFS_IMAGE}-${MACHINE}.${INITRAMFS_FSTYPES};initramfs', '', d)} \
"
OSTREE_KERNEL ?= "uImage"
OSTREE_COPY_IMAGE_BOOT_FILES = "1"
OSTREE_BOOTSCR_PRECMD ?= "\
setenv initrd_high 0x20000000; \
setenv fdt_high 0x20000000; \
setenv loadaddr 0x2000000; \
setenv initrd_addr 0x8000000; \
setenv fdt_addr 0xa000000; \
setenv no_menu yes; \
setenv console ttyAMA0; \
setenv devtype usb; \
setenv no_fatwrite yes; \
setenv devnum 0; \
setenv baudrate 9600n8; \
"

OSTREE_BSP_ARGS ?= "kmemleak=on crashkernel=256M@256M mem=4096M earlyprintk=serial,0x20"

# For ustart.img
OSTREE_NETINST_DEV ?= "/dev/sda,/dev/sdb,/dev/mmcblk0,/dev/vda"
OSTREE_NETINST_ARGS ?= " \
    ${OSTREE_CONSOLE} bl=ufsd rdinit=/install \
    instdev=${OSTREE_NETINST_DEV} instname=wrlinux \
    instbr=\$BRANCH insturl=\$URL instab=${OSTREE_USE_AB} \
    instsf=1 instdate=BUILD_DATE \
"
```

## conf/machine/axxiaarm64.conf
```bitbake
#@TYPE: Machine
#@NAME: axxiaarm64
#@DESCRIPTION: Machine configuration for Axxia AXM5616 SoC
DEFAULTTUNE = "cortexa57"
require conf/machine/include/tune-cortexa57.inc

MACHINE_FEATURES += "usbhost ext2 vfat pci"

KERNEL_IMAGETYPE = "uImage"
KERNEL_ALT_IMAGETYPE = "Image"
KERNEL_DEVICETREE = "intel/axm5616-sim.dtb \
                     intel/axm5616-victoria.dtb \
		     "

SERIAL_CONSOLES = "9600;ttyAMA0"
IMAGE_FSTYPES += "tar.bz2 wic wic.bmap"
WKS_FILE ?= "axxiaarm64-usbimage.wks"
do_image_wic[depends] += "mtools-native:do_populate_sysroot"
IMAGE_BOOT_FILES ?= "uImage axm5616-victoria.dtb"

# multilib support
MULTILIBS ?= "multilib:lib32"
DEFAULTTUNE_virtclass-multilib-lib32 ?= "armv7athf-neon"

# The loader is flashed into other device separately and not part of the SD image
OSTREE_BOOTLOADER_INCLUDE ?= ""
OSTREE_SD_UBOOT_WIC1 ?= ""
OSTREE_SD_UBOOT_WIC2 ?= ""
OSTREE_SD_UBOOT_WIC3 ?= ""
OSTREE_SD_UBOOT_WIC4 ?= ""

DEFAULT_DTB = "axm5616-victoria.dtb"

# Because of the size of boot loader is ~64M and it must be added
# to 64
OSTREE_WKS_EFI_SIZE ?= "--size=128M"
OSTREE_FDISK_FSZ ?= "128"

OSTREE_UBOOT_CMD ?= "bootm"
INITRAMFS_IMAGE ??= ""
IMAGE_BOOT_FILES_append = " \
    ${@bb.utils.contains('DISTRO_FEATURES', 'ostree', 'boot.scr', '', d)} \
    ${@bb.utils.contains('DISTRO_FEATURES', 'ostree', '${INITRAMFS_IMAGE}-${MACHINE}.${INITRAMFS_FSTYPES};initramfs', '', d)} \
"
OSTREE_KERNEL ?= "uImage"
OSTREE_COPY_IMAGE_BOOT_FILES = "1"
OSTREE_BOOTSCR_PRECMD ?= "\
setenv loadaddr 0x10000000; \
setenv initrd_addr 0x14800000; \
setenv fdt_addr 0x2000000; \
setenv no_menu yes; \
setenv console ttyAMA0; \
setenv devtype usb; \
"

# For ustart.img
OSTREE_NETINST_DEV ?= "/dev/sda,/dev/sdb,/dev/mmcblk0,/dev/vda"
OSTREE_NETINST_ARGS ?= " \
    ${OSTREE_CONSOLE} bl=ufsd rdinit=/install \
    instdev=${OSTREE_NETINST_DEV} instname=wrlinux \
    instbr=\$BRANCH insturl=\$URL instab=${OSTREE_USE_AB} \
    instsf=1 instdate=BUILD_DATE \
"
```

## wic/axxiaarm-usbimage.wks
```
# short-description: Create USB disk image with a boot partition
# long-description: Creates a partitioned USB disk image. Boot files
# are located in the first ext4 partition.

part /boot --source bootimg-partition --ondisk sda --fstype=ext4 --label boot --active --align 512 --size 16
part / --source rootfs --ondisk sda --fstype=ext4 --label root --align 512
```

## wic/axxiaarm64-usbimage.wks
```
# short-description: Create USB disk image with a boot partition
# long-description: Creates a partitioned USB disk image. Boot files
# are located in the first ext2 partition.
#
# NOTE: When using an u-boot command "ext4load" in axm56xx board, the speed
# of read will drop to less than 200KB/s. But the "ext2load" has no this
# problem. So we make the first partition an ext2 one.

part /boot --source bootimg-partition --ondisk sda --fstype=ext2 --label boot --active --align 4096 --size 64
part / --source rootfs --ondisk sda --fstype=ext4 --label root --align 4096
```
